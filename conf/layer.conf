## conf/layer.conf
```bitbake
# We have a conf and classes directory, add to BBPATH
BBPATH .= ":${LAYERDIR}"

# We have recipes-* directories, add to BBFILES
BBFILES += "${LAYERDIR}/recipes-*/*/*.bb \
	${LAYERDIR}/recipes-*/*/*.bbappend"

BBFILE_COLLECTIONS += "meta-lte-modem"
BBFILE_PATTERN_meta-lte-modem = "^${LAYERDIR}/"
BBFILE_PRIORITY_meta-lte-modem = "6"
LAYERSERIES_COMPAT_meta-lte-modem = "dunfell gatesgarth hardknott"
```
